## sdkconfig.defaults
```kconfig
# Target = ESP32-C6 (Shelly 1 Gen4)
CONFIG_IDF_TARGET="esp32c6"

# Shelly 1 Gen4 has 8 MB flash, default in ESP-IDF is 2 MB
CONFIG_ESPTOOLPY_FLASHSIZE_8MB=y
CONFIG_ESPTOOLPY_FLASHSIZE="8MB"

# ---------- Matter + Thread ----------
CONFIG_ENABLE_CHIPOBLE=y
CONFIG_BT_ENABLED=y
CONFIG_BT_NIMBLE_ENABLED=y
CONFIG_BT_NIMBLE_EXT_ADV=n
CONFIG_BT_NIMBLE_HCI_EVT_BUF_SIZE=70
CONFIG_USE_MINIMAL_MDNS=n
CONFIG_ENABLE_EXTENDED_DISCOVERY=y
# Master toggle: Thread-only Matter device. Excludes all WiFi-Matter paths
# (NetworkCommissioningDriver_WiFi, ConnectivityManagerImpl_WiFi, etc.)
CONFIG_ENABLE_MATTER_OVER_THREAD=y
CONFIG_USE_BLE_ONLY_FOR_COMMISSIONING=y
CONFIG_ENABLE_WIFI_STATION=n
CONFIG_ENABLE_WIFI_AP=n
CONFIG_OPENTHREAD_ENABLED=y
CONFIG_OPENTHREAD_FTD=y
CONFIG_OPENTHREAD_DNS_CLIENT=y
CONFIG_OPENTHREAD_SRP_CLIENT=y
# Logging: dynamic OFF, fixed at NOTE level (matches canonical Thread firmware)
CONFIG_OPENTHREAD_LOG_LEVEL_DYNAMIC=n
CONFIG_OPENTHREAD_LOG_LEVEL_NOTE=y
CONFIG_OPENTHREAD_CLI=n
CONFIG_OPENTHREAD_NUM_MESSAGE_BUFFERS=128
# Native 802.15.4 radio (not via external RCP)
CONFIG_OPENTHREAD_RADIO_NATIVE=y
# SRP Server support (Thread DNS-SD service discovery without full TBR)
CONFIG_OPENTHREAD_BORDER_ROUTER=y
# LwIP
CONFIG_LWIP_IPV6_NUM_ADDRESSES=12
CONFIG_LWIP_MULTICAST_PING=y
CONFIG_LWIP_NETIF_STATUS_CALLBACK=y
CONFIG_MDNS_MULTIPLE_INSTANCE=y

# mbedTLS: DTLS + ECJPAKE required by OpenThread secure_transport (commissioning)
CONFIG_MBEDTLS_SSL_PROTO_DTLS=y
CONFIG_MBEDTLS_ECJPAKE_C=y
CONFIG_MBEDTLS_KEY_EXCHANGE_ECJPAKE=y
CONFIG_LIBSODIUM_USE_MBEDTLS_SHA=y
CONFIG_MBEDTLS_HKDF_C=y

# Matter logs
CONFIG_LOG_DEFAULT_LEVEL_INFO=y
CONFIG_CHIP_LOG_DEFAULT_LEVEL_INFO=y

# ---------- Partitions ----------
CONFIG_PARTITION_TABLE_CUSTOM=y
CONFIG_PARTITION_TABLE_CUSTOM_FILENAME="partitions.csv"
CONFIG_PARTITION_TABLE_OFFSET=0x8000
CONFIG_PARTITION_TABLE_MD5=n
# Allow writing to the PT region (needed by migrate_partition_table_if_needed)
CONFIG_SPI_FLASH_DANGEROUS_WRITE_ALLOWED=y

# ---------- App-rollback / OTA ----------
CONFIG_BOOTLOADER_APP_ROLLBACK_ENABLE=y
CONFIG_ENABLE_OTA_REQUESTOR=y
CONFIG_ESP_HTTPS_OTA_ALLOW_HTTP=y
CONFIG_ESP_TLS_INSECURE=y
CONFIG_ESP_TLS_SKIP_SERVER_CERT_VERIFY=y
CONFIG_HTTPD_MAX_REQ_HDR_LEN=2048
CONFIG_HTTPD_MAX_URI_LEN=512

# ---------- Stack/heap tuning ----------
CONFIG_FREERTOS_HZ=1000
CONFIG_ESP_MAIN_TASK_STACK_SIZE=5120

# ---------- Matter device basics ----------
# Vendor/Product ID: 0xFFF1/0x8001 = standard test IDs (CSA).
# The display name in HA does NOT come from these IDs but from CHIPProjectConfig.h
# (CHIP_DEVICE_CONFIG_DEVICE_VENDOR_NAME / _PRODUCT_NAME).
CONFIG_DEVICE_VENDOR_ID=0xFFF1
CONFIG_DEVICE_PRODUCT_ID=0x8001
CONFIG_DEVICE_TYPE_ON_OFF_LIGHT_SWITCH=y
CONFIG_CHIP_PROJECT_CONFIG="main/CHIPProjectConfig.h"

# For development setup code = 20202021 (test vendor passcode)
CONFIG_DEFAULT_SETUP_PASSCODE=20202021
CONFIG_DEFAULT_SETUP_DISCRIMINATOR=3840


# ---------- Shelly 1 Gen4 pinout (canonical-validated, see main/Kconfig.projbuild) ----------
# Pushbutton (System 55 / wall switch) on the SW terminal — external pull on PCB
CONFIG_PIN_SWITCH_INPUT=10
# Relay output (mains-switching, active-high)
CONFIG_PIN_RELAY=5
# 1-Wire DS18B20 dual-pin via ISO7221A isolator on Shelly Plus Add-on
CONFIG_PIN_ONEWIRE_TX=9
CONFIG_PIN_ONEWIRE_RX=16
# Status LED on onboard PCB LED (active-low)
CONFIG_PIN_STATUS_LED=15
# STATUS_LED_ACTIVE_HIGH: default n (active-low) — no extra line needed
# Add-on inputs: TTP223 touch on GPIO18, LD2410 occupancy on GPIO17 — both always active
CONFIG_PIN_TOUCH_INPUT=18
CONFIG_PIN_LD2410_INPUT=17
```
